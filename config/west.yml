## config/west.yml
```yaml
manifest:
  remotes:
    - name: zmkfirmware
      url-base: https://github.com/zmkfirmware
    - name: sekigon-gonnoc
      url-base: https://github.com/sekigon-gonnoc
    - name: nat-chan
      url-base: https://github.com/nat-chan
    - name: kot149
      url-base: https://github.com/kot149
    - name: amgskobo
      url-base: https://github.com/amgskobo
  projects:
    # 実行時設定可能な速度カーブ (custom-settings含めimport)
    - name: zmk-module-runtime-accel
      remote: nat-chan
      revision: main
      import: true
    # importより優先: v0.3(Zephyr 3.5)互換パッチ済みフォークに固定
    - name: zmk-feature-custom-settings
      remote: nat-chan
      revision: v0.3-compat
    # cormoran fork (custom studio RPC対応) のnat-chanミラー
    - name: zmk
      remote: nat-chan
      revision: 35bb5dafecd5931c432c74e1b630cf12097671e4
      import: app/west.yml
    - name: zmk-component-bmp-boost
      remote: sekigon-gonnoc
      import: west.yml
      revision: v0.2
    - name: zmk-feature-status-led
      remote: sekigon-gonnoc
      revision: main
    - name: zmk-driver-paw3222
      remote: sekigon-gonnoc
      revision: torabo-tsuki
    - name: zmk-driver-iqs7211e
      remote: sekigon-gonnoc
    - name: zmk-feature-cdc-acm-bootloader-trigger
      remote: sekigon-gonnoc
      revision: v0.2
    - name: zmk-feature-non-lipo-battery-management
      remote: sekigon-gonnoc
      revision: main
    - name: zmk-mouse-gesture
      remote: kot149
      revision: v1
    - name: zmk-input-inertia
      remote: amgskobo
      revision: main
  self:
    path: config
```
