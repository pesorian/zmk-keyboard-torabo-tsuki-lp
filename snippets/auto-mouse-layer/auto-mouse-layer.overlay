/*
 * Auto Mouse Layer snippet
 *
 * Activates layer 4 (mouse layer) automatically when the trackball is moved.
 * The layer deactivates after 1000ms of inactivity.
 * Any key press EXCEPT those at excluded-positions will also deactivate the layer.
 *
 * excluded-positions: mouse click keys in layer_0 and layer_4
 *   Position 30, 31 = Thumb inner keys
 *   Position 27, 28 = D, F keys
 *   Position 34, 35 = K, L keys
 */

#include <input/processors.dtsi>

/ {
    auto_mouse_layer: auto_mouse_layer {
        compatible = "zmk,input-processor-temp-layer";
        #input-processor-cells = <2>;
        require-prior-idle-ms = <200>;
        excluded-positions = <27 28 30 31 34 35>;
    };
};

&pointing_listener {
    input-processors = <&auto_mouse_layer 4 1000>;
};
